## sdkconfig.defaults
```kconfig
# KeyBridge — ESP32 SDK configuration defaults
#
# Target: Original ESP32 (WROOM-32) with Classic BT + BLE + WiFi.
# These settings are compiled into ESP-IDF when using the combined
# arduino+espidf framework.

# Bluetooth controller
CONFIG_BT_ENABLED=y
CONFIG_BT_BLUEDROID_ENABLED=y
CONFIG_BT_BLE_ENABLED=y
CONFIG_BT_CLASSIC_ENABLED=y
CONFIG_BT_HID_ENABLED=y
CONFIG_BT_HID_HOST_ENABLED=y

# Classic BT: Secure Simple Pairing
CONFIG_BT_SSP_ENABLED=y

# BLE: use 4.2 scan APIs (required by esp_hid_gap.c)
CONFIG_BT_BLE_42_FEATURES_SUPPORTED=y
# CONFIG_BT_BLE_50_FEATURES_SUPPORTED is not set

# WiFi + BT coexistence (required for simultaneous WiFi AP + Classic BT)
CONFIG_ESP_COEX_SW_COEXIST_ENABLE=y

# Task watchdog: don't monitor IDLE0 — the scan response task runs at
# max priority on core 0 and only yields briefly between scan bursts.
# IDLE0 gets enough time to run but not enough to satisfy the default
# WDT period. Core 1 IDLE is still monitored.
CONFIG_ESP_TASK_WDT_CHECK_IDLE_TASK_CPU0=n

# Stack size for app_main (Arduino setup/loop)
CONFIG_ESP_MAIN_TASK_STACK_SIZE=8192

# Flash size (match the 4MB board)
CONFIG_ESPTOOLPY_FLASHSIZE_4MB=y

# Required by Arduino framework
CONFIG_FREERTOS_HZ=1000
```
